## CMakeLists.txt
```
cmake_minimum_required(VERSION 3.20.0)

list(APPEND ZEPHYR_EXTRA_MODULES
    ${CMAKE_CURRENT_SOURCE_DIR}/../modules/zephyr-dw3000-decadriver
)

find_package(Zephyr REQUIRED HINTS $ENV{ZEPHYR_BASE})

# The pinned decadriver includes "version.h"; Zephyr 4.5 moved it under zephyr/.
# Add the generated header directory without modifying the driver submodule.
zephyr_include_directories(${ZEPHYR_BINARY_DIR}/include/generated/zephyr)
project(ball)

target_include_directories(app PRIVATE ../shared)
target_sources(app PRIVATE src/main.c src/ble_log.c src/impact.c ../shared/uwb.c)
```

## prj.conf
```kconfig
CONFIG_DW3000=y
CONFIG_DW3000_CHIP_DW3000=y
CONFIG_SPI=y
CONFIG_GPIO=y
CONFIG_FPU=y
CONFIG_MAIN_STACK_SIZE=4096
CONFIG_LOG=y
CONFIG_LOG_DEFAULT_LEVEL=2
CONFIG_LOG_MODE_IMMEDIATE=y

# Random numbers (join back-off) and hardware ID (pouch)
CONFIG_ENTROPY_GENERATOR=y
CONFIG_HWINFO=y

# Accelerometer (ball only)
CONFIG_SENSOR=y
CONFIG_LIS2DH_ODR_RUNTIME=y
CONFIG_LIS2DH_ACCEL_RANGE_RUNTIME=y
CONFIG_LIS2DH_OPER_MODE_HIGH_RES=y
CONFIG_LIS2DH_BLOCK_DATA_UPDATE=y

# Bluetooth debug log (used only when BLE_DEBUG is defined at the top of src/main.c).
# Use the upstream Zephyr NUS service, as in examples/accel_ble_nus.
CONFIG_BT=y
CONFIG_BT_PERIPHERAL=y
CONFIG_BT_DEVICE_NAME="dodgit-ball"
CONFIG_BT_ZEPHYR_NUS=y
CONFIG_BT_ZEPHYR_NUS_DEFAULT_INSTANCE=y
CONFIG_BT_L2CAP_TX_MTU=247
CONFIG_BT_BUF_ACL_RX_SIZE=251
CONFIG_BT_BUF_ACL_TX_SIZE=251
CONFIG_BT_CTLR_DATA_LENGTH_MAX=251
CONFIG_BT_L2CAP_TX_BUF_COUNT=8
```

## src/main.c
```c
/*
 * dodgit - Ball firmware (DWM3001CDK)
 *
 * Startup ("Off" state in docs/FSMs.md):
 *   1. led3 (blue) is turned ON and stays on: it marks this board as the ball.
 *   2. Self-test: DW3110 UWB radio probe + accelerometer init.
 *      PASS: led0 (green) blinks 3 times, then the state machine starts in Roll Call.
 *      FAIL: led1 + led2 (red) blink forever (reason printed on the console).
 *
 * State machine (docs/FSMs.md "Ball Main FSM"):
 *   Roll Call -> Disarmed -> Ready -> Armed -> Classify -> (Ready | Disarmed | Inform)
 *   Inform -> Disarmed;   Reset (button held >= 3 s, any state except Roll Call) -> Disarmed
 *
 * The user button SW0 simulates the future external button:
 *   short press (< 3 s) : leave Roll Call (only once at least one pouch has registered)
 *   hold (>= 3 s)       : Reset - tell all pouches to restore their lives
 * (SW0 is unrelated to the board's hardware RESET button, which reboots the MCU.)
 *
 * The state number is shown in binary on led2 led1 led0 (led0 = 1s bit):
 *   Roll Call=0, Disarmed=1, Ready=2, Armed=3, Classify=4, Inform=5.
 * Reset blinks led0..led2 together 3 times slowly. In Roll Call led0 also flashes
 * once for every newly registered pouch.
 * There are no LED strips yet; the strip color of every state is noted in the comments.
 *
 * Everything the ball does is also printed on the console (J-Link USB serial, 115200 baud).
 * With BLE_DEBUG (below) the same log is also sent over Bluetooth: tools/ball_monitor.py.
 */

/* ---------------------------------------------------------------------------
 * DEBUG FLAG
 *   BLE_DEBUG defined : the ball advertises as "dodgit-ball" (Nordic UART Service) and
 *                       sends every log line to a connected laptop (tools/ball_monitor.py).
 *                       Nothing depends on the connection: the ball behaves exactly the
 *                       same with nobody connected, and the console log is unchanged.
 *   BLE_DEBUG removed : no Bluetooth at all (log goes to the console only).
 * (The Bluetooth stack is configured in prj.conf; it is simply never started when the
 * flag is off.)
 * ------------------------------------------------------------------------- */
// #define BLE_DEBUG

#include <zephyr/kernel.h>
#include <zephyr/drivers/gpio.h>
#include <zephyr/random/random.h>
#include "settings.h"
#include "uwb.h"
#include "impact.h"
#ifdef BLE_DEBUG
#include "ble_log.h"
#endif

#define LOOP_PERIOD_MS 10
#define HOLD_TIME_MS 3000
#define DEBOUNCE_SAMPLES 3 /* 3 consecutive loop passes with the same level */

#define RESET_BLINKS 3
#define RESET_BLINK_ON_MS 500
#define RESET_BLINK_OFF_MS 500

#define REGISTRATION_FLASH_MS 150
#define RANGE_LOG_PERIOD_MS 200
#define STATUS_LOG_PERIOD_MS 250

/* LOG(...) = printf-style log line (newline added): console always, Bluetooth too with BLE_DEBUG. */
#ifdef BLE_DEBUG
#define LOG(...) ble_log(__VA_ARGS__)
#else
#define LOG(fmt, ...) printk(fmt "\n", ##__VA_ARGS__)
#endif

/* ---------------------------------------------------------------------------
 * LEDs and button (aliases from the decawave_dwm3001cdk board DTS)
 * ------------------------------------------------------------------------- */
static const struct gpio_dt_spec leds[] = {
    GPIO_DT_SPEC_GET(DT_ALIAS(led0), gpios), /* D9  green - 1s bit */
    GPIO_DT_SPEC_GET(DT_ALIAS(led1), gpios), /* D12 red   - 2s bit */
    GPIO_DT_SPEC_GET(DT_ALIAS(led2), gpios), /* D11 red   - 4s bit */
    GPIO_DT_SPEC_GET(DT_ALIAS(led3), gpios), /* D10 blue  - identity */
};
static const struct gpio_dt_spec button = GPIO_DT_SPEC_GET(DT_ALIAS(sw0), gpios);

static void led_set(int i, bool on)
{
  gpio_pin_set_dt(&leds[i], on);
}

/* Show the low 3 bits of value on led2 led1 led0. */
static void status_leds_show(uint8_t value)
{
  for (int i = 0; i < 3; i++)
  {
    led_set(i, (value >> i) & 1);
  }
}

static bool hw_init(void)
{
  for (int i = 0; i < ARRAY_SIZE(leds); i++)
  {
    if (!gpio_is_ready_dt(&leds[i]) || gpio_pin_configure_dt(&leds[i], GPIO_OUTPUT_INACTIVE) < 0)
    {
      printk("LED %d init failed\n", i);
      return false;
    }
  }
  if (!gpio_is_ready_dt(&button) || gpio_pin_configure_dt(&button, GPIO_INPUT) < 0)
  {
    printk("Button init failed\n");
    return false;
  }
  return true;
}

/* ---------------------------------------------------------------------------
 * Button: polled every loop pass with a small debounce.
 *   BTN_SHORT - released before HOLD_TIME_MS
 *   BTN_HOLD  - fired once when HOLD_TIME_MS is reached while still pressed;
 *               the following release is swallowed (no BTN_SHORT).
 * ------------------------------------------------------------------------- */
enum btn_event
{
  BTN_NONE,
  BTN_SHORT,
  BTN_HOLD,
};

static enum btn_event button_poll(void)
{
  static bool stable;     /* debounced level, true = pressed */
  static int same_count;  /* consecutive raw samples differing from stable */
  static int64_t press_start;
  static bool hold_fired;

  bool raw = gpio_pin_get_dt(&button) > 0;
  int64_t now = k_uptime_get();

  if (raw != stable)
  {
    if (++same_count >= DEBOUNCE_SAMPLES)
    {
      stable = raw;
      same_count = 0;
      if (stable)
      {
        press_start = now;
        hold_fired = false;
      }
      else if (!hold_fired)
      {
        return BTN_SHORT;
      }
    }
  }
  else
  {
    same_count = 0;
  }

  if (stable && !hold_fired && now - press_start >= HOLD_TIME_MS)
  {
    hold_fired = true;
    return BTN_HOLD;
  }
  return BTN_NONE;
}

/* ---------------------------------------------------------------------------
 * Startup self-test
 * ------------------------------------------------------------------------- */
static void self_test_pass_blink(void)
{
  for (int i = 0; i < 3; i++)
  {
    led_set(0, true);
    k_msleep(100);
    led_set(0, false);
    k_msleep(150);
  }
}

static void self_test_fail_halt(const char *what, int rc)
{
  printk("Halting: %s failed (%d)\n", what, rc);
  while (1)
  {
    led_set(1, true);
    led_set(2, true);
    k_msleep(250);
    led_set(1, false);
    led_set(2, false);
    k_msleep(250);
  }
}

/* ---------------------------------------------------------------------------
 * Ball state machine (docs/FSMs.md)
 * ------------------------------------------------------------------------- */
enum ball_state
{
  STATE_ROLL_CALL = 0,
  STATE_DISARMED = 1,
  STATE_READY = 2,
  STATE_ARMED = 3,
  STATE_CLASSIFY = 4,
  STATE_INFORM = 5,
  STATE_RESET = 6, /* not shown in binary; has its own blink pattern */
};

static const char *state_name(enum ball_state s)
{
  switch (s)
  {
  case STATE_ROLL_CALL: return "Roll Call";
  case STATE_DISARMED: return "Disarmed";
  case STATE_READY: return "Ready";
  case STATE_ARMED: return "Armed";
  case STATE_CLASSIFY: return "Classify";
  case STATE_INFORM: return "Inform";
  case STATE_RESET: return "Reset";
  }
  return "?";
}

static enum ball_state state;
static int64_t state_entered_ms;

/* Data carried between states */
static int thrower_slot = -1;     /* pouch that was holding the ball (set on Disarmed -> Ready) */
static int hit_slot = -1;         /* pouch that was hit (set in Classify, used in Inform) */
static uint16_t hit_seq;          /* number of the current hit; the pouch ignores repeats */
static int missed_rounds;         /* Ready: consecutive rounds the thrower did not answer */
static int64_t last_checkin_ms;   /* Roll Call: when the last NEW pouch registered */
static int64_t flash_until_ms;    /* Roll Call: led0 flash end */
static int64_t last_log_ms;       /* throttle for the range log */
static uint8_t reset_acked;       /* Reset: slots that acknowledged so far */
static int64_t reset_next_send_ms;

static struct pouch_range ranges[MAX_POUCHES];

static void enter_state(enum ball_state next)
{
  LOG("State: %s -> %s", state_name(state), state_name(next));
  state = next;
  state_entered_ms = k_uptime_get();

  switch (next)
  {
  case STATE_ROLL_CALL:
    status_leds_show(0);
    uwb_ball_rollcall_start();
    break;
  case STATE_ARMED:
    uwb_ball_idle();       /* Armed: no ranging at all */
    impact_flush();        /* forget bumps from before the throw */
    status_leds_show(next);
    break;
  case STATE_RESET:
    reset_acked = 0;
    reset_next_send_ms = 0;
    status_leds_show(0x7); /* first blink starts immediately */
    break;
  default:
    status_leds_show(next);
    break;
  }
}

/* Index of the closest pouch in ranges[0..n), or -1. With need_lives, skip dead pouches. */
static int closest(int n, bool need_lives)
{
  int best = -1;
  for (int i = 0; i < n; i++)
  {
    if (need_lives && ranges[i].lives == 0)
    {
      continue;
    }
    if (best < 0 || ranges[i].mm < ranges[best].mm)
    {
      best = i;
    }
  }
  return best;
}

/* Print every pouch of the latest round, at most RANGE_LOG_PERIOD_MS apart. */
static void log_ranges(int n)
{
  int64_t now = k_uptime_get();
  if (now - last_log_ms < RANGE_LOG_PERIOD_MS)
  {
    return;
  }
  last_log_ms = now;
  if (n == 0)
  {
    LOG("RANGE %lld none answered", (long long)now);
  }
  for (int i = 0; i < n; i++)
  {
    LOG("RANGE %lld slot=%u uid=0x%08x distance=%d mm lives=%u", (long long)now,
           ranges[i].slot, ranges[i].uid, ranges[i].mm, ranges[i].lives);
  }
}

/* Roll Call (Light Strip: White)
 *   Pouches announce themselves; each new one gets the next free timeslot.
 *   Leave when SW0 is pressed (handled in main) or ROLLCALL_TIMEOUT_MS after the last
 *   NEW registration. Never leave before at least one pouch has registered. */
static void run_roll_call(void)
{
  int slot;
  uint32_t uid;
  int64_t now = k_uptime_get();

  switch (uwb_ball_rollcall_step(&slot, &uid))
  {
  case RC_NEW:
    LOG("ROLLCALL new pouch uid=0x%08x -> slot %d (%d registered)", uid, slot,
           uwb_ball_pouch_count());
    last_checkin_ms = now; /* only NEW pouches restart the timeout */
    flash_until_ms = now + REGISTRATION_FLASH_MS;
    break;
  case RC_REPEAT:
    LOG("ROLLCALL uid=0x%08x asked again, same slot %d", uid, slot);
    break;
  case RC_FULL:
    LOG("ROLLCALL uid=0x%08x ignored: all %d timeslots taken", uid, MAX_POUCHES);
    break;
  case RC_NONE:
    break;
  }
  led_set(0, now < flash_until_ms);

  if (uwb_ball_pouch_count() > 0 && now - last_checkin_ms >= ROLLCALL_TIMEOUT_MS)
  {
    LOG("ROLLCALL timeout, %d pouch(es) registered", uwb_ball_pouch_count());
    enter_state(STATE_DISARMED);
  }
}

/* Disarmed (Light Strip: Green)
 *   Constantly ranging, accelerometer not used. A pouch with lives left that is
 *   within PICKUP_DISTANCE_MM means a player picked up the ball. */
static void run_disarmed(void)
{
  int n = uwb_ball_range_round(ranges, MAX_POUCHES);
  if (n < 0)
  {
    return;
  }
  log_ranges(n);

  int c = closest(n, true);
  if (c >= 0 && ranges[c].mm <= PICKUP_DISTANCE_MM)
  {
    thrower_slot = ranges[c].slot;
    missed_rounds = 0;
    LOG("Pickup by slot %d (%d mm)", thrower_slot, ranges[c].mm);
    enter_state(STATE_READY);
  }
}

/* Ready (Light Strip: Yellow)
 *   Constantly ranging. Leaving the thrower's proximity means the ball was thrown.
 *   (Accelerometer-based throw detection is intentionally not used yet.) */
static void run_ready(void)
{
  int n = uwb_ball_range_round(ranges, MAX_POUCHES);
  if (n < 0)
  {
    return;
  }
  log_ranges(n);

  bool near = false;
  for (int i = 0; i < n; i++)
  {
    if (ranges[i].slot == thrower_slot)
    {
      near = ranges[i].mm <= LEAVE_DISTANCE_MM;
      if (!near)
      {
        LOG("Thrower slot %d is %d mm away: thrown", thrower_slot, ranges[i].mm);
        enter_state(STATE_ARMED);
        return;
      }
      missed_rounds = 0;
      return;
    }
  }
  if (++missed_rounds >= LEAVE_MISS_ROUNDS) /* out of range counts as left */
  {
    LOG("Thrower slot %d out of range: thrown", thrower_slot);
    enter_state(STATE_ARMED);
  }
}

/* Armed (Light Strip: Red)
 *   No ranging. Watch the accelerometer; an impact moves on to Classify. */
static void run_armed(void)
{
  struct impact_event ev;
  if (impact_get(&ev))
  {
    LOG("IMPACT %lld ms, %d mg", (long long)ev.time, ev.mg);
    enter_state(STATE_CLASSIFY);
  }
}

/* With only one pouch registered the thrower is always the closest pouch, so the normal
 * rule "thrower hit itself -> back to Ready" would make a hit impossible to test.
 * In that case the thrower may be hit (SELF_HIT_IF_SINGLE_POUCH in settings.h). */
static bool single_pouch_test(void)
{
  return SELF_HIT_IF_SINGLE_POUCH && uwb_ball_pouch_count() == 1;
}

/* Classify (Light Strip: Blue)
 *   One quick ranging poll (repeated a few times only if nobody answered), pick the
 *   closest pouch and decide what the impact was. */
static void run_classify(void)
{
  int n = 0;
  for (int attempt = 0; attempt < CLASSIFY_ATTEMPTS && n <= 0; attempt++)
  {
    n = uwb_ball_range_round(ranges, MAX_POUCHES);
  }
  last_log_ms = 0;
  log_ranges(n > 0 ? n : 0);

  int c = n > 0 ? closest(n, false) : -1;
  if (c < 0 || ranges[c].mm > HIT_DISTANCE_MM)
  {
    LOG("Classify: no pouch within %d mm -> miss", HIT_DISTANCE_MM);
    enter_state(STATE_DISARMED);
  }
  else if (ranges[c].slot == thrower_slot && !single_pouch_test())
  {
    LOG("Classify: closest is the thrower (slot %d) -> back to Ready", thrower_slot);
    missed_rounds = 0;
    enter_state(STATE_READY);
  }
  else
  {
    if (ranges[c].slot == thrower_slot)
    {
      LOG("Classify: thrower is the only pouch -> treating it as hit (single-pouch test)");
    }
    hit_slot = ranges[c].slot;
    hit_seq++;
    LOG("Classify: HIT on slot %d (%d mm), hit #%u", hit_slot, ranges[c].mm, hit_seq);
    enter_state(STATE_INFORM);
  }
}

/* Inform (Light Strip: Magenta)
 *   Tell the hit pouch over UWB and wait for its acknowledgment; give up after
 *   INFORM_TIMEOUT_MS so a switched-off pouch cannot lock the ball. */
static void run_inform(void)
{
  if (uwb_ball_send_hit(hit_slot, hit_seq) == 0)
  {
    LOG("HIT_ACK slot %d hit #%u", hit_slot, hit_seq);
    enter_state(STATE_DISARMED);
  }
  else if (k_uptime_get() - state_entered_ms >= INFORM_TIMEOUT_MS)
  {
    LOG("HIT_UNACKED slot %d hit #%u", hit_slot, hit_seq);
    enter_state(STATE_DISARMED);
  }
}

/* Reset (Light Strip: Cyan, blinks 3 times slowly)
 *   Broadcast RESET every RESET_RETRY_MS while blinking, collecting acknowledgments
 *   (each pouch answers in its own timeslot). After the blinks go to Disarmed. We do not
 *   wait beyond the blinks for pouches that stay silent (e.g. switched off). */
static void run_reset(void)
{
  int64_t now = k_uptime_get();
  int64_t elapsed = now - state_entered_ms;
  int64_t period = RESET_BLINK_ON_MS + RESET_BLINK_OFF_MS;

  if (elapsed >= RESET_BLINKS * period)
  {
    LOG("Reset: %d of %d pouch(es) acknowledged", __builtin_popcount(reset_acked),
           uwb_ball_pouch_count());
    enter_state(STATE_DISARMED);
    return;
  }
  status_leds_show(elapsed % period < RESET_BLINK_ON_MS ? 0x7 : 0x0);

  if (now >= reset_next_send_ms && reset_acked != uwb_ball_slot_mask())
  {
    reset_acked |= uwb_ball_send_reset();
    reset_next_send_ms = now + RESET_RETRY_MS;
  }
}

/* One status line every STATUS_LOG_PERIOD_MS in every state: lets you check the
 * accelerometer (peak |a| since the last line; ~1000 mg when sitting still) and the
 * connection without doing anything. */
static void log_status(void)
{
  static int64_t next_ms;
  int64_t now = k_uptime_get();

  if (now < next_ms)
  {
    return;
  }
  next_ms = now + STATUS_LOG_PERIOD_MS;
  LOG("STATUS %lld state=%s pouches=%d peak=%d mg accel_errors=%u", (long long)now,
     state_name(state), uwb_ball_pouch_count(), impact_take_peak(), impact_errors());
}

int main(void)
{
  printk("\n===== dodgit BALL =====\n");

  if (!hw_init())
  {
    return 0;
  }

  /* Identity: blue LED steady on for the ball, from power-up onwards. */
  led_set(3, true);

#ifdef BLE_DEBUG
  int ble_rc = ble_log_init(); /* failure is not fatal: the ball just logs to the console */
  if (ble_rc)
  {
    printk("Bluetooth debug log unavailable (%d)\n", ble_rc);
  }
#endif

  int rc = uwb_init();
  if (rc)
  {
    self_test_fail_halt("UWB radio", rc);
  }
  rc = impact_init(IMPACT_MG, IMPACT_COOLDOWN_MS);
  if (rc)
  {
    self_test_fail_halt("accelerometer", rc);
  }
  self_test_pass_blink();

  hit_seq = sys_rand32_get() & 0xFFFF; /* random start so a rebooted ball's hit numbers differ */
  state = STATE_ROLL_CALL;
  LOG("Roll Call: waiting for pouches (SW0 short press or %d s after the last one starts the game)",
         ROLLCALL_TIMEOUT_MS / 1000);
  enter_state(STATE_ROLL_CALL);

  while (1)
  {
    enum btn_event ev = button_poll();

    if (ev == BTN_HOLD && state != STATE_ROLL_CALL)
    {
      LOG("Button: hold");
      enter_state(STATE_RESET);
    }
    else if (ev == BTN_SHORT && state == STATE_ROLL_CALL)
    {
      if (uwb_ball_pouch_count() > 0)
      {
        LOG("Button: short press, ending Roll Call");
        enter_state(STATE_DISARMED);
      }
      else
      {
        LOG("Button: short press ignored, no pouch has registered yet");
      }
    }

    switch (state)
    {
    case STATE_ROLL_CALL: run_roll_call(); break;
    case STATE_DISARMED: run_disarmed(); break;
    case STATE_READY: run_ready(); break;
    case STATE_ARMED: run_armed(); break;
    case STATE_CLASSIFY: run_classify(); break;
    case STATE_INFORM: run_inform(); break;
    case STATE_RESET: run_reset(); break;
    }

    log_status();
    k_msleep(LOOP_PERIOD_MS);
  }
  return 0;
}
```

## src/ble_log.c
```c
/*
 * dodgit - ball debug log over Bluetooth. See ble_log.h.
 *
 * Uses the upstream Zephyr Nordic UART Service (CONFIG_BT_ZEPHYR_NUS),
 * as in examples/accel_ble_nus.
 *
 * Flow: ble_log() formats a line, prints it with printk and, if notifications are enabled,
 * puts it in a queue. A low-priority thread sends queued lines to the laptop, split into
 * pieces that fit the negotiated ATT notification payload. Connection and advertising are
 * handled by callbacks, so the main thread never waits for Bluetooth.
 */
#include <zephyr/kernel.h>
#include <zephyr/sys/atomic.h>
#include <zephyr/bluetooth/bluetooth.h>
#include <zephyr/bluetooth/conn.h>
#include <zephyr/bluetooth/gatt.h>
#include <zephyr/bluetooth/services/nus.h>
#include <stdio.h>
#include <stdarg.h>
#include <string.h>
#include <errno.h>
#include "ble_log.h"

struct log_line
{
  char data[160];
};

K_MSGQ_DEFINE(log_q, sizeof(struct log_line), 48, 4);
K_MUTEX_DEFINE(conn_lock);
static struct bt_conn *peer;
static atomic_t subscribed;
static atomic_t dropped;
static atomic_t ready;

uint32_t ble_log_dropped(void) { return (uint32_t)atomic_get(&dropped); }
bool ble_log_connected(void) { return atomic_get(&subscribed) != 0; }

void ble_log(const char *fmt, ...)
{
  struct log_line line;
  va_list args;

  va_start(args, fmt);
  vsnprintf(line.data, sizeof(line.data) - 1, fmt, args);
  va_end(args);
  size_t n = strlen(line.data);
  line.data[n++] = '\n';
  line.data[n] = '\0';
  printk("%s", line.data);
  if (atomic_get(&subscribed) && k_msgq_put(&log_q, &line, K_NO_WAIT))
  {
    atomic_inc(&dropped);
  }
}

/* ---------------------------------------------------------------------------
 * Advertising and connection handling
 * ------------------------------------------------------------------------- */
static const struct bt_data ad[] = {
    BT_DATA_BYTES(BT_DATA_FLAGS, BT_LE_AD_GENERAL | BT_LE_AD_NO_BREDR),
    BT_DATA(BT_DATA_NAME_COMPLETE, CONFIG_BT_DEVICE_NAME, sizeof(CONFIG_BT_DEVICE_NAME) - 1),
};
static const struct bt_data sd[] = {BT_DATA_BYTES(BT_DATA_UUID128_ALL, BT_UUID_NUS_SRV_VAL)};

static void adv_work_fn(struct k_work *work)
{
  int rc = bt_le_adv_start(BT_LE_ADV_PARAM(BT_LE_ADV_OPT_CONN, BT_GAP_ADV_FAST_INT_MIN_2,
                                           BT_GAP_ADV_FAST_INT_MAX_2, NULL),
                           ad, ARRAY_SIZE(ad), sd, ARRAY_SIZE(sd));
  printk("BLE advertising: rc=%d\n", rc);
}
K_WORK_DEFINE(adv_work, adv_work_fn);

static void connected(struct bt_conn *conn, uint8_t err)
{
  if (err)
  {
    return;
  }
  k_mutex_lock(&conn_lock, K_FOREVER);
  peer = bt_conn_ref(conn);
  k_mutex_unlock(&conn_lock);
}

static void disconnected(struct bt_conn *conn, uint8_t reason)
{
  atomic_clear(&subscribed);
  k_mutex_lock(&conn_lock, K_FOREVER);
  if (peer)
  {
    bt_conn_unref(peer);
  }
  peer = NULL;
  k_mutex_unlock(&conn_lock);
  k_msgq_purge(&log_q);
}

static void recycled(void)
{
  k_work_submit(&adv_work); /* advertise again so the laptop can reconnect */
}

BT_CONN_CB_DEFINE(conn_cbs) = {
    .connected = connected,
    .disconnected = disconnected,
    .recycled = recycled,
};

/* The laptop enabled/disabled notifications on the NUS TX characteristic. */
static void on_send_enabled(bool enabled, void *ctx)
{
  k_msgq_purge(&log_q);
  atomic_set(&subscribed, enabled);
}
static struct bt_nus_cb nus_cbs = {.notif_enabled = on_send_enabled};

int ble_log_init(void)
{
  int rc = bt_enable(NULL);
  if (rc)
  {
    return rc;
  }
  rc = bt_nus_cb_register(&nus_cbs, NULL);
  if (rc)
  {
    return rc;
  }
  atomic_set(&ready, 1);
  k_work_submit(&adv_work);
  return 0;
}

/* ---------------------------------------------------------------------------
 * Sender thread
 * ------------------------------------------------------------------------- */
static void sender(void *a, void *b, void *c)
{
  struct log_line line;

  while (1)
  {
    /* Purging on subscription/disconnect wakes waiters with an error. */
    if (k_msgq_get(&log_q, &line, K_FOREVER) || !atomic_get(&ready))
    {
      continue;
    }
    size_t len = strlen(line.data), pos = 0;
    int64_t deadline = k_uptime_get() + 1500;

    while (pos < len && atomic_get(&subscribed) && k_uptime_get() < deadline)
    {
      k_mutex_lock(&conn_lock, K_FOREVER);
      struct bt_conn *conn = peer ? bt_conn_ref(peer) : NULL;
      k_mutex_unlock(&conn_lock);
      if (!conn)
      {
        break;
      }
      /* ATT reserves three MTU bytes for the notification opcode and handle. */
      uint32_t mtu = bt_gatt_get_mtu(conn);
      size_t chunk = MIN(len - pos, mtu > 3 ? mtu - 3 : 20);
      int rc = bt_nus_send(conn, line.data + pos, chunk);
      bt_conn_unref(conn);
      if (!rc)
      {
        pos += chunk;
      }
      else if (rc != -ENOMEM && rc != -EAGAIN)
      {
        break;
      }
      k_msleep(5);
    }
    if (pos < len)
    {
      atomic_inc(&dropped);
    }
  }
}
K_THREAD_DEFINE(ble_sender, 2048, sender, NULL, NULL, NULL, 7, 0, 0);
```

## src/ble_log.h
```c
/*
 * dodgit - ball debug log over Bluetooth (Nordic UART Service).
 *
 * ble_log() always prints to the console. If a laptop is connected and has subscribed
 * (tools/ball_monitor.py) the line is also queued for sending. Logging never blocks
 * and never affects ranging or the state machine: if the queue is full or nobody is
 * connected the Bluetooth copy is simply dropped.
 */
#ifndef DODGIT_BLE_LOG_H
#define DODGIT_BLE_LOG_H

#include <stdbool.h>
#include <stdint.h>

/* Start advertising as "dodgit-ball". Returns 0 or -errno. */
int ble_log_init(void);

/* printf-style; a newline is appended. Lines are truncated at ~159 characters. */
void ble_log(const char *fmt, ...) __attribute__((format(printf, 1, 2)));

bool ble_log_connected(void);   /* a laptop is subscribed */
uint32_t ble_log_dropped(void); /* lines lost because of a full queue or a dropped link */

#endif
```

## src/impact.c
```c
/*
 * dodgit - ball accelerometer impact detector.
 *
 * A background thread reads the on-board LIS2DH12 every ACCEL_SAMPLE_PERIOD_MS and
 * computes |a| = sqrt(x^2 + y^2 + z^2) in milli-g. An impact is |a| >= threshold,
 * with hysteresis (|a| must first fall below 3/4 of the threshold) and a cooldown so
 * one shock is not counted twice. Impacts are queued; the ball's state machine only
 * looks at the queue while Armed.
 */
#include <math.h>
#include <zephyr/kernel.h>
#include <zephyr/drivers/sensor.h>
#include <zephyr/sys/atomic.h>
#include "impact.h"
#include "settings.h"

static const struct device *const accel = DEVICE_DT_GET(DT_ALIAS(accel0));
K_MSGQ_DEFINE(impact_q, sizeof(struct impact_event), 8, 4);

static atomic_t running;
static int32_t threshold_mg;
static int cooldown_ms;
static int64_t warm_until_ms;
static atomic_t peak_mg;   /* max |a| since impact_take_peak() */
static atomic_t error_count;

int impact_init(int32_t threshold, int cooldown)
{
  struct sensor_value val;

  if (!device_is_ready(accel))
  {
    return -ENODEV;
  }
  /* Impacts are far above the +/-2 g default range. */
  sensor_g_to_ms2(16, &val);
  int rc = sensor_attr_set(accel, SENSOR_CHAN_ACCEL_XYZ, SENSOR_ATTR_FULL_SCALE, &val);
  if (rc)
  {
    return rc;
  }
  val.val1 = 400;
  val.val2 = 0;
  rc = sensor_attr_set(accel, SENSOR_CHAN_ACCEL_XYZ, SENSOR_ATTR_SAMPLING_FREQUENCY, &val);
  if (rc)
  {
    return rc;
  }

  threshold_mg = threshold;
  cooldown_ms = cooldown;
  warm_until_ms = k_uptime_get() + 500;
  atomic_set(&running, 1);
  return 0;
}

bool impact_get(struct impact_event *event)
{
  return k_msgq_get(&impact_q, event, K_NO_WAIT) == 0;
}

int32_t impact_take_peak(void)
{
  return (int32_t)atomic_set(&peak_mg, 0); /* returns the old value */
}

uint32_t impact_errors(void)
{
  return (uint32_t)atomic_get(&error_count);
}

void impact_flush(void)
{
  k_msgq_purge(&impact_q);
}

static void sample_thread(void *a, void *b, void *c)
{
  bool armed_gate = true; /* hysteresis: true once |a| has dropped below 3/4 threshold */
  int64_t cooldown_until = 0;

  while (1)
  {
    k_msleep(ACCEL_SAMPLE_PERIOD_MS);
    if (!atomic_get(&running))
    {
      continue;
    }

    struct sensor_value xyz[3];
    int rc = sensor_sample_fetch(accel);
    if (!rc)
    {
      rc = sensor_channel_get(accel, SENSOR_CHAN_ACCEL_XYZ, xyz);
    }
    if (rc)
    {
      if (rc != -ENODATA)
      {
        atomic_inc(&error_count);
      }
      continue; /* no new data / read error: try again next period */
    }
    double x = sensor_value_to_double(&xyz[0]) * 1000.0 / 9.80665;
    double y = sensor_value_to_double(&xyz[1]) * 1000.0 / 9.80665;
    double z = sensor_value_to_double(&xyz[2]) * 1000.0 / 9.80665;
    int32_t mg = (int32_t)sqrt(x * x + y * y + z * z);
    int64_t now = k_uptime_get();

    if (mg > atomic_get(&peak_mg))
    {
      atomic_set(&peak_mg, mg);
    }
    if (mg < threshold_mg * 3 / 4)
    {
      armed_gate = true;
    }
    if (now >= warm_until_ms && armed_gate && now >= cooldown_until && mg >= threshold_mg)
    {
      armed_gate = false;
      cooldown_until = now + cooldown_ms;
      struct impact_event ev = {.time = now, .mg = mg};
      k_msgq_put(&impact_q, &ev, K_NO_WAIT); /* queue full: drop */
    }
  }
}
K_THREAD_DEFINE(impact_thread, 2048, sample_thread, NULL, NULL, NULL, 5, 0, 0);
```

## src/impact.h
```c
/* dodgit - ball accelerometer impact detector (background thread). */
#ifndef DODGIT_IMPACT_H
#define DODGIT_IMPACT_H

#include <stdbool.h>
#include <stdint.h>

struct impact_event {
    int64_t time; /* k_uptime_get() when the impact was seen (ms) */
    int32_t mg;   /* magnitude, milli-g */
};

/* Configure the accelerometer (+/-16 g, 400 Hz) and start detecting. Returns 0 or -errno.
 * Impacts are ignored for the first 500 ms (sensor settling). */
int impact_init(int32_t threshold_mg, int cooldown_ms);

/* Pop the oldest queued impact. Returns false if there is none. */
bool impact_get(struct impact_event *event);

/* Largest |a| (milli-g) seen since the previous call, then starts over. ~1000 when the ball
 * sits still: a quick check that the accelerometer is alive. */
int32_t impact_take_peak(void);

/* Number of failed sensor reads since boot. */
uint32_t impact_errors(void);

/* Drop all queued impacts (call when entering Armed so old bumps don't count). */
void impact_flush(void);

#endif
```
